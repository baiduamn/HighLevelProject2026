## firmware/hub/main/Kconfig.projbuild
```kconfig
menu "ESP-NOW 主机配置（hub）"

    choice HUB_LED_TYPE
        prompt "板载 LED 类型"
        default HUB_LED_TYPE_WS2812
        help
            ESP32-S3-DevKitC-1 等开发板板载 WS2812 可编程 RGB 灯；
            如果板子上是普通单色 LED，请选择“普通 GPIO LED”。

        config HUB_LED_TYPE_WS2812
            bool "WS2812 / SK6812 可编程 RGB LED"

        config HUB_LED_TYPE_GPIO
            bool "普通 GPIO LED"
    endchoice

    config HUB_LED_GPIO
        int "板载 LED 使用的 GPIO 编号"
        range 0 48
        default 48 if HUB_LED_TYPE_WS2812
        default 2 if HUB_LED_TYPE_GPIO
        help
            常见取值：
            - ESP32-S3-DevKitC-1 v1.1 的 WS2812: 48
            - ESP32-S3-DevKitC-1 v1.0 的 WS2812: 38
            - 部分第三方 S3 板卡的普通 LED: 2

    config HUB_LED_ACTIVE_LOW
        bool "普通 LED 为低电平点亮"
        depends on HUB_LED_TYPE_GPIO
        default n

endmenu
```

## firmware/hub/sdkconfig.defaults
```kconfig
# 主机固件目标芯片
CONFIG_IDF_TARGET="esp32s3"

# Flash：S3 模组最小 4MB。8MB/16MB 的板子也能用，只是上半天闲置；
# 以后需要 OTA 或存储空间时再调整分区表即可。
CONFIG_ESPTOOLPY_FLASHSIZE_4MB=y
CONFIG_ESPTOOLPY_FLASHSIZE="4MB"

# 自定义分区表：app 区 3MB（见 partitions.csv）
CONFIG_PARTITION_TABLE_CUSTOM=y
CONFIG_PARTITION_TABLE_CUSTOM_FILENAME="partitions.csv"

# 板载 LED：默认按 ESP32-S3-DevKitC-1 的 WS2812（GPIO48）配置
CONFIG_HUB_LED_TYPE_WS2812=y
CONFIG_HUB_LED_GPIO=48
```

## firmware/node/components/sensor_template/Kconfig
```kconfig
menu "Sensor template (copy this folder to start a new driver)"

    config SENSOR_TEMPLATE_I2C_PORT
        int "I2C port"
        range 0 1
        default 0

    config SENSOR_TEMPLATE_I2C_ADDR
        hex "I2C address"
        default 0x44

    config SENSOR_TEMPLATE_GPIO_SDA
        int "I2C SDA GPIO"
        range 0 48
        default 8

    config SENSOR_TEMPLATE_GPIO_SCL
        int "I2C SCL GPIO"
        range 0 48
        default 9

endmenu
```

## firmware/node/main/Kconfig.projbuild
```kconfig
menu "ESP-NOW 从机配置"

    config NODE_DEVICE_ID
        int "从机编号（1 ~ 8，主机按编号区分颜色）"
        range 1 8
        default 1
        help
            烧录到不同从机时改成各自的编号，避免主机把多块板认成同一个。
            主机最多同时区分 8 个从机。

    config NODE_BUTTON_GPIO
        int "按键 GPIO 编号"
        range 0 48
        default 0
        help
            默认 GPIO0，即开发板上的 BOOT 按键（注意：按住 BOOT 上电会进入下载模式，
            请在设备启动完成后再按）。使用外接按键时改成对应引脚。

    config NODE_BUTTON_ACTIVE_LOW
        bool "按键低电平有效（按下接地）"
        default y

    choice NODE_LED_TYPE
        prompt "板载 LED 类型"
        default NODE_LED_TYPE_WS2812

        config NODE_LED_TYPE_WS2812
            bool "WS2812 / SK6812 可编程 RGB LED"

        config NODE_LED_TYPE_GPIO
            bool "普通 GPIO LED"
    endchoice

    config NODE_LED_GPIO
        int "板载 LED 的 GPIO 编号"
        range 0 48
        default 48 if NODE_LED_TYPE_WS2812
        default 2 if NODE_LED_TYPE_GPIO
        help
            常见取值：
            - ESP32-S3-DevKitC-1 v1.1 的 WS2812: 48
            - ESP32-S3-DevKitC-1 v1.0 的 WS2812: 38
            - 部分第三方 S3 板卡的普通 LED: 2

    config NODE_LED_ACTIVE_LOW
        bool "普通 LED 为低电平点亮"
        depends on NODE_LED_TYPE_GPIO
        default n

endmenu
```

## firmware/node/sdkconfig.defaults
```kconfig
# 从机固件目标芯片
CONFIG_IDF_TARGET="esp32s3"

# Flash：S3 模组最小 4MB
CONFIG_ESPTOOLPY_FLASHSIZE_4MB=y
CONFIG_ESPTOOLPY_FLASHSIZE="4MB"

# 从机编号：烧到不同从机时改成 1 ~ 8
CONFIG_NODE_DEVICE_ID=1

# 默认使用板载 BOOT 按键（GPIO0，按下接地）
CONFIG_NODE_BUTTON_GPIO=0
CONFIG_NODE_BUTTON_ACTIVE_LOW=y

# 板载 WS2812（ESP32-S3-DevKitC-1，GPIO48）
CONFIG_NODE_LED_TYPE_WS2812=y
CONFIG_NODE_LED_GPIO=48
```
